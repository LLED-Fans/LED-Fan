## sdkconfig.defaults
```kconfig
# We're currently stuck on idf3 because of Clion compat, this has to be transferred manually.....

# ---------- General --------------

# Required for Arduino framework
CONFIG_ENABLE_ARDUINO_DEPENDS=y
CONFIG_AUTOSTART_ARDUINO=y

# Flashsize
CONFIG_ESPTOOLPY_FLASHSIZE="8MB"
CONFIG_ESPTOOLPY_FLASHSIZE_8MB=y

# CPU Frequency of 240MHZ
CONFIG_ESP32_DEFAULT_CPU_FREQ_240=y
CONFIG_ESP32_DEFAULT_CPU_FREQ_MHZ=240

# Required for network to compile
CONFIG_MBEDTLS_PSK_MODES=y

# ---------- Performance --------------

# Run everything we can on core 0, core 1 is highly speed sensitive

CONFIG_PTHREAD_TASK_CORE_DEFAULT=0
CONFIG_ESP32_PTHREAD_TASK_CORE_DEFAULT=0
CONFIG_ESP32_DEFAULT_PTHREAD_CORE_NO_AFFINITY=
CONFIG_ESP32_DEFAULT_PTHREAD_CORE_0=y
CONFIG_PTHREAD_DEFAULT_CORE_NO_AFFINITY=
CONFIG_PTHREAD_DEFAULT_CORE_0=y

CONFIG_TCPIP_TASK_AFFINITY=0
CONFIG_TCPIP_TASK_AFFINITY_NO_AFFINITY=
CONFIG_TCPIP_TASK_AFFINITY_CPU0=y

CONFIG_LWIP_TCPIP_TASK_AFFINITY=0
CONFIG_LWIP_TCPIP_TASK_AFFINITY_CPU0=y
CONFIG_LWIP_TCPIP_TASK_AFFINITY_NO_AFFINITY=


CONFIG_ARDUINO_UDP_RUN_CORE0=y
CONFIG_ARDUINO_UDP_RUN_CORE1=
CONFIG_ARDUINO_UDP_RUNNING_CORE=0

# We don't care about idle task since we don't delete xTasks
CONFIG_ESP_TASK_WDT=0

# We don't use timers, but apparently disabling them
# stops compiling, says a comment in code
CONFIG_FREERTOS_TIMER_TASK_PRIORITY=0
CONFIG_TIMER_TASK_PRIORITY=0

CONFIG_ARDUINO_EVENT_RUN_CORE0=y
CONFIG_ARDUINO_EVENT_RUN_CORE1=
CONFIG_ARDUINO_EVENT_RUNNING_CORE=0

# ---------- Debug Tools --------------

# If vTaskList is used
CONFIG_FREERTOS_USE_STATS_FORMATTING_FUNCTIONS=y
CONFIG_FREERTOS_USE_TRACE_FACILITY=y
```
